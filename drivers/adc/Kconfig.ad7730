## drivers/adc/Kconfig.ad7730
```kconfig
# SPDX-FileCopyrightText: Copyright (c) 2026 Zoltan Gyarmati
# SPDX-License-Identifier: Apache-2.0

config ADC_AD7730
	bool "Analog Devices AD7730 sigma-delta ADC driver"
	default y
	depends on DT_HAS_ADI_AD7730_ADC_ENABLED
	select SPI
	select GPIO
	help
	  Enable driver for the AD7730/AD7730L 24-bit sigma-delta ADC from
	  Analog Devices. Implements the standard Zephyr ADC driver API
	  (channel_setup/read/read_async); sinc filter tuning, burnout
	  detection, self-/system-calibration, and continuous free-running
	  streaming are exposed through the vendor extension API in ad7730.h.

if ADC_AD7730

config ADC_AD7730_INIT_PRIORITY
	int "AD7730 driver initialisation priority"
	default 80
	help
	  Device initialisation priority within the POST_KERNEL phase.
	  Must be higher than the SPI controller priority.

config ADC_AD7730_LOG_LEVEL
	int "AD7730 driver log level"
	default 3
	range 0 4
	help
	  Log verbosity: 0=off, 1=ERR, 2=WRN, 3=INF, 4=DBG.

config ADC_AD7730_CONVERSION_TIMEOUT_MS
	int "Single-conversion timeout (ms)"
	default 1000
	help
	  Maximum time to wait for a single conversion (adc_read()/
	  adc_read_async(), one channel) to complete before returning
	  -ETIMEDOUT.

config ADC_AD7730_ACQUISITION_THREAD_PRIO
	int "ADC data acquisition thread priority"
	default 0
	depends on ADC_ASYNC

config ADC_AD7730_ACQUISITION_THREAD_STACK_SIZE
	int "Stack size for the ADC data acquisition thread"
	default 512
	depends on ADC_ASYNC
	help
	  Size of the stack used for the internal data acquisition thread.

config ADC_AD7730_STREAM_THREAD_PRIO
	int "Continuous-streaming thread priority"
	default 0
	help
	  Priority of the thread that delivers ad7730_stream_start() results.

config ADC_AD7730_STREAM_THREAD_STACK_SIZE
	int "Stack size for the continuous-streaming thread"
	default 2048
	help
	  Size of the stack used by the thread backing ad7730_stream_start()/
	  ad7730_stream_stop(). The ad7730_stream_cb_t callback runs directly
	  on this thread, so size it for whatever the callback does, not just
	  the driver's own SPI I/O — e.g. the shell's demo callback alone
	  needs well over 512 bytes once shell_fprintf() is on the stack.

endif # ADC_AD7730
```

## drivers/usb/uhc/Kconfig.stm32
```kconfig
# Copyright (c) 2025 STMicroelectronics
# SPDX-License-Identifier: Apache-2.0

config UHC_STM32
	bool "STM32 USB host controller driver"
	depends on DT_HAS_ST_STM32_UHC_OTGHS_ENABLED || DT_HAS_ST_STM32N6_UHC_OTGHS_ENABLED
	select USE_STM32_LL_USB
	select USE_STM32_HAL_HCD
	select STM32_USB_COMMON
	select PINCTRL
	default y
	help
	  STM32 USB host controller (UHC) driver using the DWC2 OTG HS core.

if UHC_STM32

config UHC_STM32_STACK_SIZE
	int "UHC driver thread stack size"
	default 512
	help
	  Stack size for the STM32 UHC driver worker thread.

config UHC_STM32_THREAD_PRIORITY
	int "UHC driver thread priority"
	default 8
	help
	  Priority for the STM32 UHC driver worker thread.

config UHC_STM32_MAX_QMESSAGES
	int "Maximum number of ISR event messages"
	range 4 64
	default 8
	help
	  Maximum number of messages queued from ISR callbacks to the worker thread.

endif # UHC_STM32
```

## dts/bindings/adc/adi,ad7730-adc.yaml
```yaml
# SPDX-FileCopyrightText: Copyright (c) 2026 Zoltan Gyarmati
# SPDX-License-Identifier: Apache-2.0

description: |
  Analog Devices AD7730 / AD7730L 24-bit sigma-delta ADC for bridge transducers.

  The device uses a custom SPI protocol where every read or write must be
  preceded by a write to the Communications Register (register 0). SPI mode
  is CPOL=0, CPHA=1 (Mode 1) when the POL pin is strapped low (the common
  case); verify against the datasheet's "Serial Interface" section for your
  board's POL strap.

  Unlike a general-purpose mux'd ADC, the AD7730 has no freely selectable
  analog input pins: each channel node's `reg` selects one of four dedicated
  input pairings (see include/zephyr/dt-bindings/adc/ad7730-adc.h), so this
  binding does not need CONFIG_ADC_CONFIGURABLE_INPUTS / input-positive /
  input-negative.

  Example:

  &spi4 {
      status = "okay";

      ad7730: ad7730@0 {
          compatible = "adi,ad7730-adc";
          reg = <0>;
          spi-max-frequency = <1000000>;
          drdy-gpios = <&gpioe 3 GPIO_ACTIVE_LOW>;
          vref-mv = <2500>;
          status = "okay";

          #address-cells = <1>;
          #size-cells = <0>;
          #io-channel-cells = <1>;

          channel@0 {
              reg = <AD7730_CH_1>;
              zephyr,gain = "ADC_GAIN_1";
              zephyr,reference = "ADC_REF_EXTERNAL0";
              zephyr,acquisition-time = <ADC_ACQ_TIME_DEFAULT>;
              zephyr,resolution = <24>;
              zephyr,differential;
          };
      };
  };

compatible: "adi,ad7730-adc"

include: [adc-controller.yaml, spi-device.yaml]

io-channel-cells:
  - input

properties:
  drdy-gpios:
    type: phandle-array
    description: |
      GPIO connected to the AD7730 /DRDY signal. When CS is deasserted the
      DOUT pin goes low to indicate a conversion result is ready; route this
      signal to a GPIO for interrupt-driven conversion completion. Configure
      with GPIO_ACTIVE_LOW. Falls back to status-register polling if absent.

  vref-mv:
    type: int
    enum: [2500, 5000]
    default: 2500
    description: |
      External reference voltage wired to the board's REFIN pins. Selects
      the HIREF bit in the Mode Register, which affects the reference input
      buffer, not an internal reference source — the AD7730 has none.

  unipolar:
    type: boolean
    description: |
      If true, the ADC operates in unipolar mode (0 to +Vfs output coding).
      Default is bipolar (-Vfs to +Vfs, offset binary), matching the chip's
      power-on reset default and typical load-cell bridge usage.

  reg:
    required: true
```

## dts/bindings/usb/st,stm32-uhc-otghs-common.yaml
```yaml
# Copyright (c) 2025, STMicroelectronics
# SPDX-License-Identifier: Apache-2.0

# Common fields for STM32 OTGHS USB host controller

include: [usb-controller.yaml, pinctrl-device.yaml]

properties:
  reg:
    required: true

  interrupts:
    required: true

  ram-size:
    type: int
    required: true
    description: Size of USB dedicated SRAM in bytes.

  phys:
    type: phandle
    description: PHY provider specifier

  clocks:
    required: true
```

## dts/bindings/usb/st,stm32n6-uhc-otghs.yaml
```yaml
# Copyright (c) 2025, STMicroelectronics
# SPDX-License-Identifier: Apache-2.0

description: |
  STM32 OTGHS USB host controller without pinmux.

  On series such as STM32N6, the pinctrl-0 and pinctrl-names properties
  are not needed as dedicated pins are reserved for USB communication.

compatible: "st,stm32n6-uhc-otghs"

include: st,stm32-uhc-otghs-common.yaml
```
